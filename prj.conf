## CMakeLists.txt
```
cmake_minimum_required(VERSION 3.20.0)

find_package(Zephyr REQUIRED HINTS $ENV{ZEPHYR_BASE})
project(temp_reader)

# Include nanopb module
list(APPEND CMAKE_MODULE_PATH ${ZEPHYR_BASE}/modules/nanopb)
include(nanopb)

# Include usb module
include(${ZEPHYR_BASE}/samples/subsys/usb/common/common.cmake)

# Include protobuf message definition
zephyr_nanopb_sources(app proto/message.proto)

FILE(GLOB app_sources src/*.c)
target_sources(app PRIVATE ${app_sources})
```

## west.yml
```
manifest:
  projects:
    - name: zephyr
      revision: v3.7.0
      url: https://github.com/zephyrproject-rtos/zephyr
      import: true

self:
  path: temp-reader
```

## prj.conf
```kconfig
CONFIG_NO_OPTIMIZATIONS=n
CONFIG_MAIN_STACK_SIZE=4096
CONFIG_SYSTEM_WORKQUEUE_STACK_SIZE=4096
CONFIG_USB_WORKQUEUE_STACK_SIZE=4096

CONFIG_LOG=y
CONFIG_LOG_PRINTK=y
CONFIG_LOG_CMDS=y

CONFIG_INIT_STACKS=y
CONFIG_THREAD_STACK_INFO=y
CONFIG_STATS=y
CONFIG_STATS_SHELL=y
CONFIG_THREAD_RUNTIME_STATS=y
CONFIG_THREAD_RUNTIME_STATS_USE_TIMING_FUNCTIONS=y

CONFIG_USB_DEVICE_STACK=y
CONFIG_USB_DEVICE_PRODUCT="Temperature Reader"
CONFIG_USB_DEVICE_PID=0x0004
CONFIG_USB_DEVICE_INITIALIZE_AT_BOOT=n

CONFIG_SHELL=y
CONFIG_SERIAL=y
CONFIG_CONSOLE=y
CONFIG_UART_CONSOLE=y
CONFIG_UART_LINE_CTRL=n


CONFIG_GPIO=y
CONFIG_GPIO_SHELL=y

CONFIG_NANOPB=y
```

## src/main.c
```c
/*
 * temp_reader
 *
 * Copyright (c) [2024] [DM]
 * Licensed under the MIT License.
 * See LICENSE file in the project root for full license information.
 */

#include <stdbool.h>
#include "app.h"

#include <zephyr/logging/log.h>

LOG_MODULE_REGISTER(main);

int main(void)
{
    LOG_INF("Starting...");
    app_init();
    app_run();
    return 0;
}
```

## src/app.c
```c
/**
 * temp_reader
 *
 * Copyright (c) [2024] [DM]
 * Licensed under the MIT License.
 * See LICENSE file in the project root for full license information.
 */

#include "app.h"

#include <math.h>
#include <stdint.h>
#include <stdio.h>
#include <stdlib.h>

#include <zephyr/logging/log.h>

#include "basic_osal.h"
#include "conf.h"
#include "host_interface.h"
#include "sensor.h"

#include "pb_decode.h"
#include "pb_encode.h"

LOG_MODULE_REGISTER(app);

// this is a workaround to keep zephyr thread related code outside
#define THREAD_STACK_SIZE 1024
static uint8_t sensor_thread_stack[THREAD_STACK_SIZE];

// Functions providing text-based interface
static int read_sensor_text(int argc, const char **argv);
static int enable_sensor_text(int argc, const char **argv);
static int disable_sensor_text(int argc, const char **argv);
static int config_sensor_text(int argc, const char **argv);
static int toggle_interface_mode_text(int argc, const char **argv);

// Functions providing binare-based-interface
static int read_sensor_bin(const Request *request);
static int config_sensor_bin(const Request *request);
static int toggle_interface_mode_bin(const Request *request);

typedef int (*text_command_handler_t)(int argc, const char **argv);
typedef int (*bin_command_handler_t)(const Request *request);

typedef struct {
    char cmd[16];
    char desc[44];
    text_command_handler_t handler;
} text_command_t;

// Registringn  supported text commands
static text_command_t text_commands[] = {
    { "read", "Read sensor data. Ex: app read 1 2 3", read_sensor_text },
    { "enable", "Enable sensors. Ex: app enable 1 2 3", enable_sensor_text },
    { "disable", "Disable sensors. Ex: app disable 1 2 3", disable_sensor_text },
    { "config", "Configure sensor", config_sensor_text },
    { "toggle", "Switch interface to binary mode", toggle_interface_mode_text },
};

typedef struct {
    RequestType type;
    bin_command_handler_t handler;
} bin_command_t;

// Registring supported binary commands
static bin_command_t bin_commands[] = {
    { RequestType_Toggle, toggle_interface_mode_bin },
    { RequestType_ReadData, read_sensor_bin },
    { RequestType_ConfigSensor, config_sensor_bin },
};

// Dispatches the incoming text command to a dedicated handler
int process_host_text(int argc, const char **argv)
{
    int res = -1;
    if (argc < 2) {
        host_send_text("Please specify application command\n");
        for (int i = 0; i < sizeof text_commands / sizeof text_commands[0]; i++) {
            host_send_text("  * %-8s\t%s\n", text_commands[i].cmd, text_commands[i].desc);
        }
        return res;
    }
    bool handler_found = false;

    for (int i = 0; i < sizeof text_commands / sizeof text_commands[0]; i++) {
        if (strcmp(argv[1], text_commands[i].cmd) == 0) {
            res           = text_commands[i].handler(argc - 2, &argv[2]);
            handler_found = true;
            break;
        }
    }
    if (!handler_found) {
        host_send_text("Unknown command: %s\n", argv[1]);
    }

    return res;
}

// Dispatches the incoming binary command to a dedicated header
int process_host_bin(const uint8_t *data, size_t len)
{
    Request request      = Request_init_zero;
    pb_istream_t istream = pb_istream_from_buffer(data, len);

    int res     = -1;
    bool status = pb_decode(&istream, Request_fields, &request);

    if (!status) {
        host_send_text("Failed to decode request\n");
        return 1;
    }

    bool handler_found = false;

    for (int i = 0; i < sizeof bin_commands / sizeof bin_commands[0]; i++) {
        if (bin_commands[i].type == request.type) {
            res           = bin_commands[i].handler(&request);
            handler_found = true;
            break;
        }
    }
    if (!handler_found) {
        host_send_text("Unknown command: %d\n", request.type);
    }
    return res;
}

void app_init()
{
    // Do low-level hardware initialization
    // In zephyr this would probably go to pre-main board init
    low_level_init();

    // Initializing communications
    host_interface_init();

    // Initializing configuration
    conf_init();

    // Now that we have a config, starting up sensors, and polling thread
    sensor_init();
    osal_start_thread(sensor_poll, NULL, sensor_thread_stack, sizeof sensor_thread_stack, 5);

    // setup host interface callbacks
    host_set_text_cb(process_host_text);
    host_set_bin_cb(process_host_bin);
}

void app_run()
{
    // Nothing to do, so lets spin around
    while (true) {
        osal_sleep_ms(1000);
    }
}

// From here and below the code parsing and responding to interface command
// I belive that the code is straightforward
static int read_sensor_text(int argc, const char **argv)
{
    host_send_text("Read command received\n");
    if (argc <= 0) {
        host_send_text("Please specify one or more sensor ids (space separated)\n");
        return -1;
    }

    for (int i = 0; i < argc; i++) {
        uint32_t sensor_id = atoi(argv[i]);
        if (sensor_id < 0 || sensor_id >= MAX_SENSOR_COUNT) {
            continue;
        }
        // to skip including huge-ass floating formatting code, lets
        // manually convert float to a string
        float temp = sensor_get_temp(sensor_id);
        if (isnan(temp)) {
            host_send_text("\tSensor[%zd] is offline\n", sensor_id);
            continue;
        }
        int i_t = temp;
        int f_t = (temp * 100 - i_t * 100);
        if (f_t < 0) {
            f_t *= -1;
        }
        host_send_text("\tSensor[%zd] = %d.%02dC\n", sensor_id, i_t, f_t);
    }
    return 0;
}

static int enable_sensor_text(int argc, const char **argv)
{
    if (argc <= 0) {
        host_send_text("\tUsage:\napp enable <sensor_id> <sensor_id> ...\n");
        return -1;
    }
    for (int i = 0; i < argc; i++) {
        uint32_t sensor_id = atoi(argv[i]);
        if (sensor_id < 0 || sensor_id >= MAX_SENSOR_COUNT) {
            continue;
        }
        if (sensor_set_enabled(sensor_id, true) != 0) {
            host_send_text("\tFailed to enable sensor[%zd]. Please check its configuration\n",
                           sensor_id);
            continue;
        }
        else {
            host_send_text("\tSensor[%zd] enabled\n", sensor_id);
        }
        sensor_refresh_data(sensor_id);
    }
    return 0;
}

static int disable_sensor_text(int argc, const char **argv)
{
    if (argc <= 0) {
        host_send_text("\tUsage:\napp disable <sensor_id> <sensor_id> ...\n");
        return -1;
    }
    for (int i = 0; i < argc; i++) {
        uint32_t sensor_id = atoi(argv[i]);
        if (sensor_id < 0 || sensor_id >= MAX_SENSOR_COUNT) {
            continue;
        }
        sensor_set_enabled(sensor_id, false);
    }
    return 0;
}

static int config_sensor_text(int argc, const char **argv)
{
    if (argc <= 1) {
        host_send_text("\tUsage:\napp config <sensor_id> <interval> <offset> <coef>\n");
        return -1;
    }

    uint32_t sensor_id = atoi(argv[0]);
    if (sensor_id < 0 || sensor_id >= MAX_SENSOR_COUNT) {
        host_send_text("Incorrect sensor id\n");
        host_send_text("\tUsage:\napp config <sensor_id> <interval> <offset> <coef>\n");
        return -1;
    }
    if (argc > 1) {
        uint32_t interval = atoi(argv[1]);
        if (sensor_set_interval(sensor_id, interval) == 0) {
            host_send_text("Interval set to: %dms\n", interval);
        }
        else {
            host_send_text("Failed to set interval to: %dms\n", interval);
        }
    }
    if (argc > 2) {
        int32_t offset = atoi(argv[2]);
        if (sensor_set_offset(sensor_id, offset) == 0) {
            host_send_text("Calibration offset set to: %d\n", offset);
        }
        else {
            host_send_text("Failed to set calibration offset to: %d\n", offset);
        }
    }
    if (argc > 3) {
        float coef = atof(argv[3]);
        if (sensor_set_coef(sensor_id, coef) == 0) {
            host_send_text("Calibration coefficient set to: %s\n", argv[3]);
        }
        else {
            host_send_text("Failed to set calibration coefficient to: %s\n", argv[3]);
        }
    }
    sensor_refresh_data(sensor_id);
    return 0;
}

static int toggle_interface_mode_text(int argc, const char **argv)
{
    host_send_text("Interface will switch to binary mode\n");
    host_send_text("Use binary command to return back to text mode, or reset the device\n");
    host_set_mode(HOST_INTERFACE_BIN);
    return 0;
}

static int toggle_interface_mode_bin(const Request *request)
{
    Response response = Response_init_zero;
    response.status   = Status_SUCCESS;
    response.type     = RequestType_Toggle;

    uint8_t buffer[Response_size];
    pb_ostream_t ostream = pb_ostream_from_buffer(buffer, sizeof buffer);

    bool status = pb_encode(&ostream, Response_fields, &response);
    if (status) {
        host_send_bin(buffer, ostream.bytes_written);
    }

    host_set_mode(HOST_INTERFACE_TEXT);
    host_send_text("Interface switched to text mode\n");
    return 0;
}

static int config_sensor_bin(const Request *request)
{
    Response response = Response_init_zero;
    response.status   = Status_SUCCESS;
    response.type     = RequestType_ConfigSensor;

    uint32_t sensor_id = request->request.config.sensor_id;

    if (sensor_id > 0 && sensor_id < MAX_SENSOR_COUNT) {
        if (request->request.config.command == ConfigSensorCommand_SetConfig) {
            if (request->request.config.has_coef) {
                sensor_set_coef(sensor_id, request->request.config.coef);
            }
            if (request->request.config.has_offset) {
                sensor_set_offset(sensor_id, request->request.config.offset);
            }
            if (request->request.config.has_interval) {
                sensor_set_interval(sensor_id, request->request.config.interval);
            }
            if (sensor_get_enabled(sensor_id)) {
                sensor_refresh_data(sensor_id);
            }
        }
        else if (request->request.config.command == ConfigSensorCommand_Enable) {
            if (sensor_set_enabled(sensor_id, true) == 0) {
                sensor_refresh_data(sensor_id);
            }
            else {
                response.status = Status_GENERAL_FAILURA;
            }
        }
        else if (request->request.config.command == ConfigSensorCommand_Disable) {
            sensor_set_enabled(sensor_id, false);
        }
        else {
            response.status = Status_GENERAL_FAILURA;
        }
    }
    else {
        response.status = Status_INVALID_SENSOR_ID;
    }

    uint8_t buffer[Response_size];
    pb_ostream_t ostream = pb_ostream_from_buffer(buffer, sizeof buffer);

    bool status = pb_encode(&ostream, Response_fields, &response);
    if (status) {
        host_send_bin(buffer, ostream.bytes_written);
    }
    return 0;
}

static int read_sensor_bin(const Request *request)
{
    Response response = Response_init_zero;
    response.status   = Status_SUCCESS;
    response.type     = RequestType_ReadData;

    uint32_t sensor_id = request->request.read_data.sensor_id;

    response.type = request->type;

    if (sensor_id >= 0 && sensor_id < MAX_SENSOR_COUNT) {
        if (!sensor_get_enabled(sensor_id)) {
            response.status = Status_SENSOR_OFFLINE;
        }
        else {
            int32_t temp                   = sensor_get_temp(request->request.read_data.sensor_id);
            response.has_temperature       = true;
            response.temperature.sensor_id = sensor_id;
            response.temperature.data      = temp;
        }
    }
    else {
        response.status = Status_INVALID_SENSOR_ID;
    }

    uint8_t buffer[Response_size];
    pb_ostream_t ostream = pb_ostream_from_buffer(buffer, sizeof buffer);

    bool status = pb_encode(&ostream, Response_fields, &response);
    if (status) {
        host_send_bin(buffer, ostream.bytes_written);
    }

    return 0;
}
```

## src/app.h
```c
/**
 * temp_reader
 *
 * Copyright (c) [2024] [DM]
 * Licensed under the MIT License.
 * See LICENSE file in the project root for full license information.
 */

/*
 * Main app module
 * - Launches all the background threads
 * - Handles the device interactions with the outside world
 */
#pragma once

void app_init();
void app_run();
```

## src/basic_osal.c
```c
/**
 * temp_reader
 *
 * Copyright (c) [2024] [DM]
 * Licensed under the MIT License.
 * See LICENSE file in the project root for full license information.
 */
#include "basic_osal.h"
#include <stddef.h>
#include <stdint.h>
#include <stdlib.h>

// Zephyr
#include <zephyr/kernel.h>
#include <zephyr/usb/usb_device.h>

#define STACK_SIZE 1024

K_THREAD_STACK_DEFINE(stack0, STACK_SIZE);

int low_level_init()
{
    if (usb_enable(NULL)) {
        return -1;
    }
    return 0;
}

int osal_setup_timer(uint32_t time_ms, timer_cb cb)
{
    // TODO
    return 0;
}

int osal_sleep_ms(uint32_t time_ms)
{
    k_sleep(K_MSEC(time_ms));
    return 0;
}

int osal_sleep_ms_until(uint32_t time_ms, void *sem)
{
    struct k_sem *semaphore = sem;
    int ret                 = k_sem_take(semaphore, K_MSEC(time_ms));
    return ret;
}

// Thats correct, we can only create a single semaphore
// no time
static struct k_sem _sem;
void *osal_sem_create()
{
    struct k_sem *sem = &_sem;
    if (sem == NULL) {
        return NULL;
    }

    k_sem_init(sem, 0, 1);
    return sem;
}

int osal_sem_give(void *sem)
{
    if (sem == NULL) {
        return -EINVAL;
    }

    k_sem_give((struct k_sem *) sem);
    return 0;
}

int osal_sem_take(void *sem, uint32_t time_ms)
{
    if (sem == NULL) {
        return -EINVAL;
    }

    return k_sem_take((struct k_sem *) sem, K_MSEC(time_ms));
}

uint32_t osal_get_system_time_ms(void)
{
    return k_uptime_get_32();
}

void *osal_start_thread(
    void (*entry_func)(void *), void *param, void *stack, size_t stack_size, int priority)
{
    static struct k_thread thread_data;

    if (stack_size < STACK_SIZE) {
        printk("Stack size is too small.\n");
        return NULL;
    }

    k_thread_create(&thread_data,
                    stack0,
                    sizeof stack0,
                    (k_thread_entry_t) entry_func,
                    param,
                    NULL,
                    NULL,
                    priority,
                    0,
                    K_NO_WAIT);

    return &thread_data;
}
```

## src/basic_osal.h
```c
/**
 * temp_reader
 *
 * Copyright (c) [2024] [DM]
 * Licensed under the MIT License.
 * See LICENSE file in the project root for full license information.
 */

/*
 * This is a naive an barely usable OSAL wrapper for Zephyr.
 * Logging subsystem was left out intentionally
 *
 * To port the app to another OS, you will need to reimplement functions here to map
 * them to os primitives of your choice
 */
#pragma once

#include <ctype.h>
#include <stdint.h>

typedef void (*timer_cb)(void);

int low_level_init();

int osal_setup_timer(uint32_t time_ms, timer_cb cb);
int osal_sleep_ms(uint32_t time_ms);
int osal_sleep_ms_until(uint32_t time_ms, void *sem);
void *osal_sem_create();
int osal_sem_give(void *sem);
int osal_sem_take(void *sem, uint32_t time_ms);
uint32_t osal_get_system_time_ms();
void *osal_start_thread(
    void (*entry_func)(void *), void *param, void *stack, size_t stack_size, int priority);
```

## src/conf.c
```c
/**
 * temp_reader
 *
 * Copyright (c) [2024] [DM]
 * Licensed under the MIT License.
 * See LICENSE file in the project root for full license information.
 */

#include "conf.h"

#include <zephyr/sys/util.h>

static sensor_conf_t sensor_conf_s[] = { {
    .interval   = 1000,
    .cal_offset = 0,
    .cal_coef   = 1,
} };

bool conf_init()
{
    // Initialize hardware / interface / whatever
    return true;
}

bool conf_get_sensor(size_t idx, sensor_conf_t *sensor_conf)
{
    if (idx >= ARRAY_SIZE(sensor_conf_s)) {
        return false;
    }
    *sensor_conf = sensor_conf_s[idx];
    return true;
}

bool conf_set_sensor(size_t idx, const sensor_conf_t *sensor_conf)
{
    if (idx >= ARRAY_SIZE(sensor_conf_s)) {
        return false;
    }
    // save the data
    return true;
}
```

## src/conf.h
```c
/**
 * temp_reader
 *
 * Copyright (c) [2024] [DM]
 * Licensed under the MIT License.
 * See LICENSE file in the project root for full license information.
 */

/*
 * Configuration provider
 *
 * Depending on the requirements of the project could interface
 * onboard flash/eeprom, request the data from the host or anything else
 *
 * for now we just fallback to the static default config
 *
 */
#pragma once

#include <stdbool.h>
#include <stddef.h>
#include <stdint.h>

typedef struct {
    uint32_t interval;
    int32_t cal_offset;
    float cal_coef;
    uint32_t _padding;
} sensor_conf_t;

bool conf_init();
bool conf_get_sensor(size_t idx, sensor_conf_t *sensor_conf);
bool conf_set_sensor(size_t idx, const sensor_conf_t *sensor_conf);
```

## src/host_interface.c
```c
/**
 * temp_reader
 *
 * Copyright (c) [2024] [DM]
 * Licensed under the MIT License.
 * See LICENSE file in the project root for full license information.
 */
#include "host_interface.h"

#include <ctype.h>
#include <stdarg.h>

#include <stdlib.h>
#include <zephyr/drivers/uart.h>
#include <zephyr/kernel.h>
#include <zephyr/logging/log.h>
#include <zephyr/posix/unistd.h>
#include <zephyr/shell/shell.h>
#include <zephyr/shell/shell_uart.h>
#include <zephyr/usb/usb_device.h>
#include <zephyr/version.h>

static host_interface_mode_t mode_s = HOST_INTERFACE_TEXT;

static host_text_cb text_cb_s = NULL;
static host_bin_cb bin_cb_s   = NULL;

static const struct device *const shell_uart = DEVICE_DT_GET(DT_CHOSEN(zephyr_shell_uart));
static const struct shell *shell_s;

static int cmd_app(const struct shell *sh, size_t argc, const char **argv)
{
    if (text_cb_s) {
        return text_cb_s(argc, argv);
    }
    return 0;
}

static int cmd_version(const struct shell *sh, size_t argc, char **argv)
{
    ARG_UNUSED(argc);
    ARG_UNUSED(argv);

    shell_print(sh, "Zephyr version %s", KERNEL_VERSION_STRING);
    shell_print(sh, "Application version %s", "1.0");

    return 0;
}

SHELL_CMD_ARG_REGISTER(version, NULL, "Show app version", cmd_version, 1, 0);
SHELL_CMD_ARG_REGISTER(app, NULL, "App command", cmd_app, 1, 99);

static void bypass_cb(const struct shell *sh, uint8_t *data, size_t len)
{
    if (bin_cb_s) {
        bin_cb_s(data, len);
    }

    return;
}

void host_set_text_cb(host_text_cb cb)
{
    text_cb_s = cb;
}

void host_set_bin_cb(host_bin_cb cb)
{
    bin_cb_s = cb;
}

void host_send_text(const char *fmt, ...)
{
    va_list args;
    va_start(args, fmt);

    shell_vfprintf(shell_s, SHELL_NORMAL, fmt, args);

    va_end(args);
}

void host_send_bin(const uint8_t *data, size_t len)
{
    for (int i = 0; i < len; i++) {
        uart_poll_out(shell_uart, data[i]);
    }
}

int host_set_mode(host_interface_mode_t mode)
{
    if (mode != mode_s) {
        mode_s = mode;
        if (mode == HOST_INTERFACE_TEXT) {
            shell_set_bypass(shell_s, NULL);
            return 0;
        }
        else if (mode == HOST_INTERFACE_BIN) {
            shell_set_bypass(shell_s, bypass_cb);
            return 0;
        }
    }
    return -1;
}

host_interface_mode_t host_get_mode()
{
    return mode_s;
}

int host_interface_init()
{
    shell_s = shell_backend_uart_get_ptr();
    return 0;
}
```

## src/host_interface.h
```c
/**
 * temp_reader
 *
 * Copyright (c) [2024] [DM]
 * Licensed under the MIT License.
 * See LICENSE file in the project root for full license information.
 */

/*
 * Wraps the host interface communications, providing platform independent
 * functions
 */

#pragma once

#include "proto/message.pb.h"

typedef enum
{
    HOST_INTERFACE_TEXT,
    HOST_INTERFACE_BIN,
} host_interface_mode_t;

typedef int (*host_text_cb)(int argc, const char **argv);
typedef int (*host_bin_cb)(const uint8_t *data, size_t len);

int host_interface_init();

int host_set_mode(host_interface_mode_t mode);
host_interface_mode_t host_get_mode();

void host_set_text_cb(host_text_cb cb);
void host_set_bin_cb(host_bin_cb cb);

void host_send_text(const char *fmt, ...);
void host_send_bin(const uint8_t *data, size_t len);
```

## src/sensor.c
```c
/**
 * temp_reader
 *
 * Copyright (c) [2024] [DM]
 * Licensed under the MIT License.
 * See LICENSE file in the project root for full license information.
 */

#include "sensor.h"

#include <math.h>
#include <stdatomic.h>
#include <stdbool.h>
#include <stdlib.h>
#include <zephyr/logging/log.h>
#include "basic_osal.h"
#include "conf.h"

LOG_MODULE_REGISTER(sensor);

static void sensor_read(size_t idx);

// Here I chose to not use any heavy locking such as mutexes or condvars
// all the data that could be accessed by several threads is stored in atomics
//
// deliberatly kept as standalone arrays instead of array of a struct
static atomic_int sensor_reading[MAX_SENSOR_COUNT];
static atomic_int sensor_timeout[MAX_SENSOR_COUNT];
static atomic_uint sensor_read_freq[MAX_SENSOR_COUNT];
static atomic_bool sensor_enabled[MAX_SENSOR_COUNT];

// these two are only accesed from a single thread
// no need for extra protection.
// If the sensor data will be read from any thread other than
// host interface, you would need to provide locking
static float sensor_coef[MAX_SENSOR_COUNT];
static int32_t sensor_offset[MAX_SENSOR_COUNT];
static void *sem_s;

void sensor_init()
{
    sem_s = osal_sem_create();
    for (size_t i = 0; i < MAX_SENSOR_COUNT; i++) {
        sensor_conf_t conf;
        bool res = conf_get_sensor(i, &conf);
        if (res) {
            atomic_init(&sensor_read_freq[i], conf.interval);
            atomic_init(&sensor_enabled[i], true);
            sensor_coef[i]   = conf.cal_coef;
            sensor_offset[i] = conf.cal_offset;
        }
        else {
            atomic_init(&sensor_read_freq[i], UINT32_MAX);
            atomic_init(&sensor_enabled[i], false);
            sensor_coef[i]   = 1;
            sensor_offset[i] = 0;
        }
    }
}

void sensor_poll()
{
    static uint32_t sleep_time = 0;
    while (true) {
        int32_t next_reading_delay = INT32_MAX;
        uint32_t cycle_begin       = osal_get_system_time_ms();
        for (size_t i = 0; i < MAX_SENSOR_COUNT; i++) {
            if (!atomic_load(&sensor_enabled[i])) {
                continue;
            }

            atomic_fetch_sub(&sensor_timeout[i], sleep_time);

            if (atomic_load(&sensor_timeout[i]) <= 0) {
                sensor_read(i);
                atomic_fetch_add(&sensor_timeout[i], atomic_load(&sensor_read_freq[i]));
                // if timeout is still negative, that probably means
                // that this sensor was just enabled, it is okay to just reset it
                if (atomic_load(&sensor_timeout[i]) <= 0) {
                    atomic_store(&sensor_timeout[i], atomic_load(&sensor_read_freq[i]));
                }
            }

            // calculate time for the next wake up
            int32_t time_left = atomic_load(&sensor_timeout[i]);
            if (time_left < next_reading_delay) {
                next_reading_delay = time_left;
            }
        }

        osal_sleep_ms_until(next_reading_delay, sem_s);
        sleep_time = osal_get_system_time_ms() - cycle_begin;
    }
}

float sensor_get_temp(uint32_t idx)
{
    if (atomic_load(&sensor_enabled[idx])) {
        int32_t temp = atomic_load(&sensor_reading[idx]);
        return (temp * sensor_coef[idx]) + sensor_offset[idx];
    }
    else {
        return NAN;
    }
}

int sensor_set_interval(uint32_t idx, uint32_t interval_ms)
{
    if (idx < 0 || idx >= MAX_SENSOR_COUNT) {
        return -1;
    }
    // If interval is longer then a day, it is probably an error
    if (interval_ms < 100 || interval_ms > 1 * 24 * 60 * 60 * 1000) {
        return -1;
    }
    // first update frequency
    atomic_store(&sensor_read_freq[idx], interval_ms);
    // then schedule for re-reading out of order
    atomic_store(&sensor_timeout[idx], 0);
    osal_sem_give(sem_s);
    return 0;
}

int sensor_set_config(uint32_t idx, uint32_t interval, int32_t offset, float coef)
{
    if (idx < 0 || idx >= MAX_SENSOR_COUNT) {
        return -1;
    }
    atomic_store(&sensor_read_freq[idx], interval);
    sensor_offset[idx] = offset;
    sensor_coef[idx]   = coef;

    return 0;
}

int32_t sensor_get_offset(uint32_t idx)
{
    return sensor_offset[idx];
}

float sensor_get_coef(uint32_t idx)
{
    return sensor_coef[idx];
}

uint32_t sensor_get_interval(uint32_t idx)
{
    return atomic_load(&sensor_read_freq[idx]);
}

int sensor_set_offset(uint32_t idx, int32_t offset)
{
    if (idx < 0 || idx >= MAX_SENSOR_COUNT) {
        return -1;
    }
    sensor_offset[idx] = offset;

    return 0;
}

int sensor_set_coef(uint32_t idx, float coef)
{
    if (idx < 0 || idx >= MAX_SENSOR_COUNT) {
        return -1;
    }
    if (isnan(coef) || coef == 0) {
        return -1;
    }
    sensor_coef[idx] = coef;

    return 0;
}

int sensor_set_enabled(uint32_t idx, bool enabled)
{
    if (idx < 0 || idx >= MAX_SENSOR_COUNT) {
        return -1;
    }

    if (sensor_coef[idx] == 0 || isnan(sensor_coef[idx]) ||
        atomic_load(&sensor_read_freq[idx]) < 100) {
        return -1;
    }

    atomic_store(&sensor_enabled[idx], enabled);
    return 0;
}

bool sensor_get_enabled(uint32_t idx)
{
    if (idx < 0 || idx >= MAX_SENSOR_COUNT) {
        return false;
    }

    return atomic_load(&sensor_enabled[idx]);
}

int sensor_refresh_data(uint32_t idx)
{
    if (idx < 0 || idx >= MAX_SENSOR_COUNT) {
        return -1;
    }
    osal_sem_give(sem_s);
    return 0;
}

// Here you may access hardware, trigger adc, send i2c command, pend an event
static void sensor_read(size_t idx)
{
    // random data
    atomic_store(&sensor_reading[idx], rand() % 10 + 20);
    // incrementing counter useful to verify timings
    // atomic_fetch_add(&sensor_reading[idx], 1);
}
```

## src/sensor.h
```c
/**
 * temp_reader
 *
 * Copyright (c) [2024] [DM]
 * Licensed under the MIT License.
 * See LICENSE file in the project root for full license information.
 */

/*
 * Basic sensor interface module,
 * Performs sensor polling and provides data in a thread-safe maner
 */
#pragma once
#include <stdbool.h>
#include <stddef.h>
#include <stdint.h>

#define MAX_SENSOR_COUNT 256

void sensor_init();
void sensor_poll();

float sensor_get_temp(uint32_t idx);
int32_t sensor_get_offset(uint32_t idx);
float sensor_get_coef(uint32_t idx);
uint32_t sensor_get_interval(uint32_t idx);
bool sensor_get_enabled(uint32_t idx);

int sensor_set_config(uint32_t idx, uint32_t interval, int32_t offset, float coef);

int sensor_set_offset(uint32_t idx, int32_t offset);
int sensor_set_coef(uint32_t idx, float coef);
int sensor_set_interval(uint32_t idx, uint32_t interval);
int sensor_set_enabled(uint32_t idx, bool enabled);
int sensor_refresh_data(uint32_t idx);
```
